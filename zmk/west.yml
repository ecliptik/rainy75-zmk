## zmk/west.yml
```yaml
manifest:
  remotes:
    - name: zmkfirmware
      url-base: https://github.com/zmkfirmware
    - name: zephyrproject-rtos
      url-base: https://github.com/zephyrproject-rtos
  projects:
    - name: zmk
      remote: zmkfirmware
      revision: 64daf698e073e37b6748ac54f4eb48d8666af0b9
      path: zmk-src
      import: app/west.yml
    - name: hal_telink
      remote: zephyrproject-rtos
      revision: main
      path: modules/hal/hal_telink
    - name: mcuboot
      remote: zephyrproject-rtos
      revision: v2.2.0
      path: bootloader/mcuboot
  self:
    path: zmk
```
